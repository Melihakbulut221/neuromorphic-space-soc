/* Bare-metal link map for the BOOT LOADER (hw/soc/tb/sw/boot.c), the
 * program that lives in the boot ROM from docs/68 onward.
 *
 * The sibling link_soc.ld put the whole bring-up program in the ROM and
 * relocated its .data to RAM; docs/66 section 7.1 then measured that
 * the program had OUTGROWN the ROM -- 7,826 of the 8,064 bytes above
 * the reset vector, with the two flash checks needing 1,800 more. This
 * script and link_app.ld are the split that ends that: the ROM holds a
 * loader and the program is linked to run from RAM, out of an image in
 * the flash.
 *
 * TWO THINGS ARE DIFFERENT FROM link_soc.ld AND BOTH ARE LOAD-BEARING.
 *
 * 1. THE LOADER'S OWN RAM IS AT THE TOP AND THE IMAGE GOES AT THE
 *    BOTTOM. The loader is writing the RAM that its own .data, .bss and
 *    stack are in, so the two must not overlap: __boot_private is the
 *    base of the loader's private region, the loader refuses any image
 *    whose load address plus length reaches it (boot.c's geometry
 *    check), and the ASSERT below is what makes the region's size a
 *    link-time fact rather than a comment.
 *
 * 2. THERE IS NO .bss ZEROING LOOP TO SIZE. boot_crt0.S sweeps EVERY
 *    word of the RAM before it touches anything, because an SRAM whose
 *    rows carry SECDED check bits (docs/67) powers up with check bits
 *    that are not a codeword, and the first read of a word nothing has
 *    written is an UNCORRECTABLE and a bus error -- not a zero. The
 *    sweep is strictly stronger than zeroing .bss and this script's
 *    __bss_start/__bss_end exist only so the sweep's bounds can be
 *    checked against them.
 *
 * The MEMORY block is INCLUDEd from memmap.ld, generated by
 * regmap/generate_memmap.py, for link_soc.ld's reason: no human writes
 * the reset vector down twice.
 */

INCLUDE memmap.ld

OUTPUT_ARCH(riscv)
ENTRY(_start)

/* The loader's private RAM: the top 1 KiB, holding .data, .bss and the
 * stack. Everything below it is the image's, and boot.c will not load
 * an image that reaches it. */
__boot_private_bytes = 0x400;
__boot_private = __soc_ram_top - __boot_private_bytes;

SECTIONS {
  .text : {
    *(.text.start)
    *(.text .text.*)
  } > rom

  /* Its own output section and 256-byte aligned, for link_soc.ld's
     reason: Ibex forces mtvec[7:2] to zero, and an input section of
     .text with that alignment would raise the whole output section's
     alignment and move _start off the reset vector. */
  .trapvec : { *(.trapvec) } > rom

  .rodata : {
    . = ALIGN(4);
    *(.rodata .rodata.*)
    . = ALIGN(4);
  } > rom

  /* Run in the loader's private RAM at the top, loaded from ROM. The
     VMA is written explicitly so that the loader's own data sits above
     any image it will load; the ALIGN is outside the section so that
     LOADADDR(.data) is exactly __data_load and boot_crt0.S's relocation
     loop copies from where it thinks it does. */
  .data __boot_private : {
    PROVIDE(__global_pointer$ = . + 0x800);
    __data_start = .;
    *(.data .data.*)
    *(.sdata .sdata.*)
    . = ALIGN(4);
    __data_end = .;
  } > ram AT> rom

  __data_load = LOADADDR(.data);

  .bss (NOLOAD) : {
    . = ALIGN(4);
    __bss_start = .;
    *(.bss .bss.*) *(.sbss .sbss.*) *(COMMON)
    . = ALIGN(4);
    __bss_end = .;
  } > ram

  . = ALIGN(16);
  __boot_stack_bottom = .;
  . = __soc_ram_top;
  __boot_stack_top = .;

  /DISCARD/ : { *(.comment) *(.note.*) *(.riscv.attributes) }
}

ASSERT(_start == __soc_reset_vector,
       "_start must sit on Ibex's reset vector, {boot_addr_i[31:8], 8'h80}")
ASSERT((boot_trap_vectors & 0xff) == 0,
       "boot_trap_vectors must be 256-byte aligned: Ibex forces mtvec[7:2] to 0")
ASSERT(boot_trap_vectors_end - boot_trap_vectors == 128,
       "the 32-entry vector table must be exactly 128 bytes")
ASSERT(__data_start == __boot_private,
       "the loader's .data must start exactly at __boot_private, or boot_crt0.S's relocation copies from the wrong offset")
ASSERT(__boot_stack_bottom <= __boot_stack_top,
       "the loader's private RAM is full: .data and .bss leave no room for a stack")
